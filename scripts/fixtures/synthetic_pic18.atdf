# PIC18SYN01 register map
Vendor: Microchip
Architecture 18xxxx. Special function registers and configuration words.
Registers are access not given, no defined reset value unless marked. A register's access mark holds for its fields unless they carry their own. Addresses are absolute, and some are shared; only a register's first bit layout is shown; lines under a group give offsets from that group; [hi:lo] are bit positions; {n}, {i} and the like mark numbered series; 'fields as' and 'values as' point back to an identical list; <NAME> marks a mode.

## CONFIG — Configuration words, addresses in ProgramSpace
0x300000 CONFIGX
  [0] ALPHA
    1=ON; 0=OFF
0x300002 CONFIGY
  [0] GAMMA
    3=THREE; 1=ONE; 0=ZERO
